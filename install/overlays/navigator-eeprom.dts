// Binds the at24 driver to the Navigator ID EEPROM at 0x50 on i2c_vc.

/dts-v1/;
/plugin/;

/ {
    compatible = "brcm,bcm2835";

    fragment@0 {
        target = <&i2c_vc>;
        __overlay__ {
            #address-cells = <1>;
            #size-cells = <0>;

            eeprom@50 {
                compatible = "atmel,24c32";
                reg = <0x50>;
                pagesize = <32>;
                size = <4096>;
            };
        };
    };
};
